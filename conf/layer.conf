## conf/machine/beacon-imx8mm-12.conf
```bitbake
#@TYPE: Machine
#@NAME: Beacon i.MX 8M Mini Development Kit
#@SOC: i.MX8MM
#@DESCRIPTION: Machine configuration for Beacon i.MX 8M Mini Development Kit
#@MAINTAINER: Adam Ford <aford@beaconembedded.com>

require include/imx8mm-beacon-kit.inc

# New Radio is based on NXP 8997 Chipset
MACHINE_FEATURES += " nxp8997"

KERNEL_DEVICETREE_BASENAME = "imx8mm-beacon"
KERNEL_DEVICETREE:append:use-nxp-bsp = " \
    freescale/${KERNEL_DEVICETREE_BASENAME}-lvds.dtb \
    freescale/${KERNEL_DEVICETREE_BASENAME}-spidev.dtb \
"

UBOOT_CONFIG_BASENAME = "imx8mm_beacon"
UBOOT_CONFIG[fspi] = "${UBOOT_CONFIG_BASENAME}_fspi_defconfig"

DDR_FIRMWARE_NAME = " \
    lpddr4_pmu_train_1d_imem.bin \
    lpddr4_pmu_train_1d_dmem.bin \
    lpddr4_pmu_train_2d_imem.bin \
    lpddr4_pmu_train_2d_dmem.bin \
"

IMXBOOT_TARGETS_BASENAME = "flash_evk"

IMX_DEFAULT_BSP = "nxp"

WKS_FILE_DEPENDS:append:beacon-imx8mm-kit = " imx-m4-demos"
IMAGE_BOOT_FILES:append:beacon-imx8mm-kit = " \
    mcore-demos/imx8mm_m4_TCM_hello_world.bin \
    mcore-demos/imx8mm_m4_TCM_rpmsg_lite_pingpong_rtos_linux_remote.bin \
    mcore-demos/imx8mm_m4_TCM_rpmsg_lite_str_echo_rtos.bin \
"
```

## conf/machine/beacon-imx8mm-4g-12.conf
```bitbake
#@TYPE: Machine
#@NAME: Beacon i.MX 8M Mini Development Kit
#@SOC: i.MX8MM
#@DESCRIPTION: Machine configuration for Beacon i.MX 8M Mini Development Kit
#@MAINTAINER: Adam Ford <aford@beaconembedded.com>

require include/imx8mm-beacon-kit.inc
require conf/machine/include/moal.inc

# New Radio is based on NXP 8997 Chipset
MACHINE_FEATURES += " nxp8997-sdio"

KERNEL_DEVICETREE_BASENAME = "imx8mm-beacon-12"
KERNEL_DEVICETREE = " \
    freescale/${KERNEL_DEVICETREE_BASENAME}-kit.dtb \
    freescale/${KERNEL_DEVICETREE_BASENAME}-lvds.dtb \
    freescale/${KERNEL_DEVICETREE_BASENAME}-spidev.dtb \
"
UBOOT_CONFIG_BASENAME = "imx8mm_beacon_4g_12"
UBOOT_CONFIG[fspi] = "${UBOOT_CONFIG_BASENAME}_fspi_defconfig"

DDR_FIRMWARE_NAME = " \
    lpddr4_pmu_train_1d_imem.bin \
    lpddr4_pmu_train_1d_dmem.bin \
    lpddr4_pmu_train_2d_imem.bin \
    lpddr4_pmu_train_2d_dmem.bin \
"

IMXBOOT_TARGETS_BASENAME = "flash_evk"

IMX_DEFAULT_BSP = "nxp"

WKS_FILE_DEPENDS:append = " imx-m4-demos"
IMAGE_BOOT_FILES:append = " \
    mcore-demos/imx8mm_m4_TCM_hello_world.bin \
    mcore-demos/imx8mm_m4_TCM_rpmsg_lite_pingpong_rtos_linux_remote.bin \
    mcore-demos/imx8mm_m4_TCM_rpmsg_lite_str_echo_rtos.bin \
"

# Kernel modules
KERNEL_MODULE_AUTOLOAD += " \
    ov5640 \
    moal \
"
KERNEL_MODULE_PROBECONF += "moal"
module_conf_moal = "options moal mod_para=nxp/wifi_mod_para.conf"
```

## conf/machine/beacon-imx8mn-kit.conf
```bitbake
#@TYPE: Machine
#@NAME: Beacon i.MX 8M Nano Development Kit
#@SOC: i.MX8MM
#@DESCRIPTION: Machine configuration for Beacon i.MX 8M Nano Development Kit
#@MAINTAINER: Adam Ford <aford@beaconembedded.com>

require include/imx8mn-beacon-kit.inc
# Use this for the Laird/Summit Radio Only
require conf/machine/include/laird.inc

KERNEL_DEVICETREE_BASENAME = "imx8mn-beacon"
KERNEL_DEVICETREE:append:use-nxp-bsp = " \
    freescale/${KERNEL_DEVICETREE_BASENAME}-lvds.dtb \
    freescale/${KERNEL_DEVICETREE_BASENAME}-spidev.dtb \
"

UBOOT_CONFIG_BASENAME = "imx8mn_beacon"

DDR_FIRMWARE_NAME = " \
    lpddr4_pmu_train_1d_imem.bin \
    lpddr4_pmu_train_1d_dmem.bin \
    lpddr4_pmu_train_2d_imem.bin \
    lpddr4_pmu_train_2d_dmem.bin \
"
IMXBOOT_TARGETS_BASENAME = "flash_evk"

IMX_DEFAULT_BSP = "nxp"

WKS_FILE_DEPENDS:append:beacon-imx8mn-kit = " imx-m7-demos"
IMAGE_BOOT_FILES:append:beacon-imx8mn-kit = " \
    mcore-demos/imx8mn_m7_TCM_hello_world.bin \
    mcore-demos/imx8mn_m7_TCM_rpmsg_lite_pingpong_rtos_linux_remote.bin \
    mcore-demos/imx8mn_m7_TCM_rpmsg_lite_str_echo_rtos.bin \
    mcore-demos/imx8mn_m7_TCM_sai_low_power_audio.bin \
"
```
