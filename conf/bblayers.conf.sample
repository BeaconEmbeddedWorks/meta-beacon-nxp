## conf/bblayers.conf.sample
```bitbake
LCONF_VERSION = "7"

BSPDIR := "${@os.path.abspath(os.path.dirname(d.getVar('FILE', True)) + '/../..')}"
BBPATH = "${TOPDIR}"
BBFILES ?= ""

BBLAYERS = " \
  ##OEROOT##/meta \
  ##OEROOT##/meta-poky \
  ##OEROOT##/../meta-openembedded/meta-oe \
  ##OEROOT##/../meta-openembedded/meta-multimedia \
  ##OEROOT##/../meta-openembedded/meta-python \
  ##OEROOT##/../meta-beacon-nxp \
  ##OEROOT##/../meta-beacon-common \
  ##OEROOT##/../meta-freescale \
  ##OEROOT##/../meta-freescale-3rdparty \
  ##OEROOT##/../meta-freescale-distro \
  ##OEROOT##/../meta-imx/meta-bsp \
  ##OEROOT##/../meta-imx/meta-sdk \
  ##OEROOT##/../meta-imx/meta-ml \
  ##OEROOT##/../meta-imx/meta-v2x \
  ##OEROOT##/../meta-nxp-demo-experience \
  ##OEROOT##/../meta-browser/meta-chromium \
  ##OEROOT##/../meta-clang \
  ##OEROOT##/../meta-openembedded/meta-gnome \
  ##OEROOT##/../meta-openembedded/meta-networking \
  ##OEROOT##/../meta-openembedded/meta-filesystems \
  ##OEROOT##/../meta-qt5\
  ##OEROOT##/../meta-python2 \
  "
  
```

## conf/local.conf.sample
```bitbake
MACHINE ??= "beacon-imx8mp-kit"


DISTRO ?= 'fsl-imx-xwayland'
PACKAGE_CLASSES ?= "package_rpm"
EXTRA_IMAGE_FEATURES ?= "debug-tweaks"
USER_CLASSES ?= "buildstats"
PATCHRESOLVE = "noop"
BB_DISKMON_DIRS ??= "\
    STOPTASKS,${TMPDIR},1G,100K \
    STOPTASKS,${DL_DIR},1G,100K \
    STOPTASKS,${SSTATE_DIR},1G,100K \
    STOPTASKS,/tmp,100M,100K \
    HALT,${TMPDIR},100M,1K \
    HALT,${DL_DIR},100M,1K \
    HALT,${SSTATE_DIR},100M,1K \
    HALT,/tmp,10M,1K"
PACKAGECONFIG:append:pn-qemu-system-native = " sdl"
CONF_VERSION = "2"

DL_DIR ?= "${BSPDIR}/downloads/"
SSTATE_DIR="${BSPDIR}/cache/"

# Switch to Debian packaging and include package-management in the image
PACKAGE_CLASSES = "package_deb"
EXTRA_IMAGE_FEATURES += "package-management"


#For iMX8M Mini and Nano based SOMS modify default recipe wifi
#components to support Laird LWB5
PREFERRED_RPROVIDER_wireless-regdb-static:mx8mm-nxp-bsp = "wireless-regdb"
PREFERRED_RPROVIDER_wpa-supplicant:mx8mm-nxp-bsp = "sterling-supplicant"
PREFERRED_RPROVIDER_wpa-supplicant-cli:mx8mm-nxp-bsp = "sterling-supplicant"
PREFERRED_RPROVIDER_wpa-supplicant-passphrase:mx8mm-nxp-bsp = "sterling-supplicant"

PREFERRED_RPROVIDER_wireless-regdb-static:mx8mn-nxp-bsp = "wireless-regdb"
PREFERRED_RPROVIDER_wpa-supplicant:mx8mn-nxp-bsp = "sterling-supplicant"
PREFERRED_RPROVIDER_wpa-supplicant-cli:mx8mn-nxp-bsp = "sterling-supplicant"
PREFERRED_RPROVIDER_wpa-supplicant-passphrase:mx8mn-nxp-bsp = "sterling-supplicant"

PREFERRED_RPROVIDER_wpa-supplicant:mx8mp-nxp-bsp = "wpa-supplicant"
PREFERRED_RPROVIDER_wpa-supplicant-cli:mx8mp-nxp-bsp = "wpa-supplicant"
PREFERRED_RPROVIDER_wpa-supplicant-passphrase:mx8mp-nxp-bsp = "wpa-supplicant"
PREFERRED_RPROVIDER_wireless-regdb-static:mx8mp-nxp-bsp = "wireless-regdb"

BBMASK:mx8mm-nxp-bsp += "recipes-connectivity/nxp-wlan-sdk/nxp-wlan-sdk_git"
BBMASK:mx8mm-nxp-bsp += "recipes-kernel/kernel-modules/kernel-module-nxp89xx"

BBMASK:mx8mn-nxp-bsp += "recipes-connectivity/nxp-wlan-sdk/nxp-wlan-sdk_git"
BBMASK:mx8mn-nxp-bsp += "recipes-kernel/kernel-modules/kernel-module-nxp89xx"
LWB_REGDOMAIN = "US"

# The default distribution uses systemd, so set the initscripts accordingly
VIRTUAL-RUNTIME_initscripts = "systemd-compat-units"

COPY_LIC_MANIFEST = "1"
COPY_DIRS = "1"
LICENSE_CREATE_PACKAGE = "1"

#To build ML from NXP uncomment the two lines below
#IMAGE_INSTALL:append = "packagegroup-imx-ml"
#TOOLCHAIN_TARGET_TASK:append += " tensorflow-lite-staticdev tensorflow-lite-dev armnn-dev onnxruntime-dev"
```

## conf/machine/beacon-imx8mm-4g-kit.conf
```bitbake
#@TYPE: Machine
#@NAME: NXP i.MX 8M Mini EVK with LPDDR4
#@SOC: i.MX8MM
#@DESCRIPTION: Machine configuration for NXP i.MX 8M Mini Evaluation Kit with LPDDR4
#@MAINTAINER: Jun Zhu <junzhu@nxp.com>
#@MAINTAINER: Richard Feliciano <richard.feliciano@beaconembedded.com>

require include/beacon-imx8mm-4gb-kit.inc

#Overiding the default imx wic configuration file.  This will
#change the rootfs label 
SOC_DEFAULT_WKS_FILE:mx8m = "imx-beacon-boot-bootpart2.wks.in"


# Device tree for Beacon EmbeddedWorks i.MX8MM Kit
KERNEL_DEVICETREE_BASENAME = "imx8mm-beacon"
KERNEL_DEVICETREE:append:use-nxp-bsp = " \
	freescale/${KERNEL_DEVICETREE_BASENAME}-kit.dtb \
"

DDR_FIRMWARE_NAME = " \
	lpddr4_pmu_train_1d_imem.bin \
	lpddr4_pmu_train_1d_dmem.bin \
	lpddr4_pmu_train_2d_imem.bin \
	lpddr4_pmu_train_2d_dmem.bin \
"

IMXBOOT_TARGETS_BASENAME = "flash_evk"
```

## conf/machine/beacon-imx8mn-2g-kit.conf
```bitbake
#@TYPE: Machine
#@NAME: Beacon i.MX8MN SOM Development Kit
#@SOC: i.MX8MN
#@DESCRIPTION: Machine configuration for Beacon i.MX8M Nano SOM Development Kit
#@MAINTAINER: Richard Feliciano <richard.feliciano@BeaconEmbedded.com>

MACHINEOVERRIDES =. "mx8:mx8m:mx8mn:"

require conf/machine/include/imx-base.inc
require conf/machine/include/arm/armv8a/tune-cortexa53.inc

#Overiding the default imx wic configuration file.  This will
#change the rootfs label 
SOC_DEFAULT_WKS_FILE:mx8m = "imx-beacon-boot-bootpart2.wks.in"

MACHINE_FEATURES += " pci wifi bluetooth"

# Device tree for Beacon EmbeddedWorks i.MX8MN Kit
KERNEL_DEVICETREE_BASENAME = "imx8mn-beacon"
KERNEL_DEVICETREE:append:use-nxp-bsp = " \
	freescale/${KERNEL_DEVICETREE_BASENAME}-kit.dtb \
	freescale/${KERNEL_DEVICETREE_BASENAME}-lvds.dtb \
	freescale/${KERNEL_DEVICETREE_BASENAME}-spidev.dtb \
"

IMAGE_BOOTFILES_DEPENDS += "imx-m4-demos:do_deploy"
IMAGE_BOOTFILES += "imx8mn_m4_TCM_hello_world.bin \
                    imx8mn_m4_TCM_rpmsg_lite_pingpong_rtos_linux_remote.bin \
                    imx8mn_m4_TCM_rpmsg_lite_str_echo_rtos.bin \
                    imx8mn_m4_TCM_sai_low_power_audio.bin \
"

UBOOT_CONFIG ??= "sd"
UBOOT_CONFIG[sd] = "beacon_imx8mn_2g_defconfig,sdcard"
UBOOT_CONFIG[fspi] = "beacon_imx8mn_fspi_2g_defconfig"
SPL_BINARY = "spl/u-boot-spl.bin"

# Set DDR FIRMWARE
DDR_FIRMWARE_NAME = "lpddr4_pmu_train_1d_imem.bin lpddr4_pmu_train_1d_dmem.bin lpddr4_pmu_train_2d_imem.bin lpddr4_pmu_train_2d_dmem.bin"

# Set u-boot DTB
UBOOT_DTB_NAME = "beacon-imx8mn-kit.dtb"

# Set imx-mkimage boot target
IMXBOOT_TARGETS = "${@bb.utils.contains('UBOOT_CONFIG', 'fspi', 'flash_evk_flexspi', 'flash_evk', d)}"

SERIAL_CONSOLES = "115200;ttymxc1"

IMAGE_BOOTLOADER = "imx-boot"

BOOT_SPACE = "65536"

LOADADDR = ""
UBOOT_SUFFIX = "bin"
UBOOT_MAKE_TARGET = ""
IMX_BOOT_SEEK = "32"
```

## conf/machine/include/beacon-imx8mm-4gb-kit.inc
```bitbake
MACHINEOVERRIDES =. "imx-boot-container:mx8:mx8m:mx8mm:"

require conf/machine/include/imx-base.inc
require conf/machine/include/arm/armv8a/tune-cortexa53.inc

MACHINE_FEATURES += "pci wifi bluetooth"

UBOOT_DTB_NAME = "${KERNEL_DEVICETREE_BASENAME}-kit.dtb"

IMX_DEFAULT_BOOTLOADER_use-nxp-bsp = "u-boot-imx"
IMX_DEFAULT_BOOTLOADER_use-mainline-bsp = "u-boot-fslc"

UBOOT_SUFFIX = "bin"

UBOOT_CONFIG ??= "sd"
UBOOT_CONFIG[sd] = "imx8mm_4g_beacon_defconfig,sdcard"
#UBOOT_CONFIG[fspi] = "beacon_imx8mm_fspi_defconfig"
SPL_BINARY = "spl/u-boot-spl.bin"

ATF_PLATFORM = "imx8mm"
ATF_LOAD_ADDR = "0x920000"

# Extra firmware package name, that is required to build boot container for fslc bsp
IMX_EXTRA_FIRMWARE = "firmware-imx-8m"

IMXBOOT_TARGETS = "${@bb.utils.contains('UBOOT_CONFIG', 'fspi', '${IMXBOOT_TARGETS_BASENAME}_flexspi', '${IMXBOOT_TARGETS_BASENAME}', d)}"

IMX_BOOT_SOC_TARGET = "iMX8MM"

SERIAL_CONSOLES = "115200;ttymxc1"

LOADADDR = ""
UBOOT_SUFFIX = "bin"
UBOOT_MAKE_TARGET = "all"
IMX_BOOT_SEEK = "33"

OPTEE_BIN_EXT = "8mm"
TEE_LOAD_ADDR = "0xbe000000"

BBMASK:mx8mm-nxp-bsp += "recipes-connectivity/nxp-wlan-sdk/nxp-wlan-sdk_git"
BBMASK:mx8mm-nxp-bsp += "recipes-kernel/kernel-modules/kernel-module-nxp89xx"
```
